## boards/raspberrypi/rpi_4b/Kconfig.defconfig
```kconfig
# Copyright 2023 honglin leng <a909204013@gmail.com>
# SPDX-License-Identifier: Apache-2.0

config BOARD_RPI_4B_IVSHMEM
	select SOC_BCM2711

config BOARD
	default "Raspberry Pi 4 Model B"
	depends on BOARD_RPI_4B_IVSHMEM

if IPM

config IPM_GIC_SGI
	default y

endif # IPM
```
